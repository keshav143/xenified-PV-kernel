## arch/x86/xen/Kconfig
```kconfig
#
# This Kconfig describes xen options
#

config XEN
	bool "Xen guest support"
	select PARAVIRT
	select PARAVIRT_CLOCK
	depends on X86_64 || (X86_32 && X86_PAE && !X86_VISWS)
	depends on X86_CMPXCHG && X86_TSC
	help
	  This is the Linux Xen port.  Enabling this will allow the
	  kernel to boot in a paravirtualized environment under the
	  Xen hypervisor.

config XEN_PVHVM
	def_bool y
	depends on XEN
	depends on X86_LOCAL_APIC

config XEN_MAX_DOMAIN_MEMORY
       int
       default 128
       depends on XEN
       help
         This only affects the sizing of some bss arrays, the unused
         portions of which are freed.

config XEN_SAVE_RESTORE
       bool
       depends on XEN && PM
       default y

config XEN_DEBUG_FS
	bool "Enable Xen debug and tuning parameters in debugfs"
	depends on XEN && DEBUG_FS
	default n
	help
	  Enable statistics output and various tuning options in debugfs.
	  Enabling this option may incur a significant performance overhead.

config SWIOTLB_XEN
       def_bool y
       depends on XEN && SWIOTLB

config MICROCODE_XEN
       def_bool y
       depends on XEN_DOM0 && MICROCODE

config XEN_DOM0
	bool "Enable Xen privileged domain support"
	depends on XEN && X86_IO_APIC && ACPI
	help
	  The Xen hypervisor requires a privileged domain ("dom0") to
	  actually manage the machine, provide devices drivers, etc.
	  This option enables dom0 support.  A dom0 kernel can also
	  run as an unprivileged domU kernel, or a kernel running
	  native on bare hardware.

# Dummy symbol since people have come to rely on the PRIVILEGED_GUEST
# name in tools.
config XEN_PRIVILEGED_GUEST
	def_bool XEN_DOM0

config XEN_DOM0_PCI
       def_bool y
       depends on XEN_DOM0 && PCI
       select PCI_XEN

config XEN_PCI_PASSTHROUGH
       bool "Enable support for Xen PCI passthrough devices"
       depends on XEN && PCI
       select PCI_XEN
       select SWIOTLB_XEN
       help
         Enable support for passing PCI devices through to
	 unprivileged domains. (COMPLETELY UNTESTED)
```
